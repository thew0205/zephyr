## drivers/can/Kconfig.uart_to_can
```kconfig
module = CAN_UART_TO_CAN
module-str = can_uart_to_can

config CAN_UART_TO_CAN
    bool "Enable can_uart_to_can driver"
    default y
	depends on DT_HAS_POWERLABS_UART_TO_CAN_ENABLED
    select UART
    help
        Enable can_uart_to_can driver

config CAN_UART_TO_CAN_ASYNC_API
    bool "Use UART asynchronous API in can_uart_to_can"
    depends on CAN_UART_TO_CAN && UART_ASYNC_API
    help
      Use UART asynchronous API for can_uart_to_can.
      When disabled, can_uart_to_can uses UART interrupt-driven API.
```

## dts/bindings/can/powerlabs,uart-to_can.yaml
```yaml
compatible: "powerlabs,uart-to-can"

description: |
    This binding provides a UART-to-CAN bridge for use in Zephyr.
    
include: can-controller.yaml

properties:
  uart_device:
    description: |
      The UART device to use for the UART-to-CAN bridge.
    type: phandle
    required: true
```
